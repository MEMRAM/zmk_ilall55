/*
 * KT55 Left half - physical layout for ZMK Studio.
 *
 * Coordinates are in "key units" x100 (100 = 1u). This is a simple
 * uniform 1u grid matching the matrix-transform key order below; feel
 * free to tweak x/y/rotation per key to match your real PCB once you
 * know exact switch placement (it only affects how the layout is
 * drawn in ZMK Studio, not how the firmware scans keys).
 */

#include <physical_layouts.dtsi>

/ {
    physical_layout0: physical_layout_0 {
        compatible = "zmk,physical-layout";
        display-name = "KT55 Left";
        transform = <&default_transform>;
        kscan = <&kscan0>;

        keys
            = &key_physical_attrs 100 100 0 0 0 0 0
            , &key_physical_attrs 100 100 100 0 0 0 0
            , &key_physical_attrs 100 100 200 0 0 0 0
            , &key_physical_attrs 100 100 300 0 0 0 0
            , &key_physical_attrs 100 100 400 0 0 0 0
            , &key_physical_attrs 100 100 500 0 0 0 0
            , &key_physical_attrs 100 100 0 100 0 0 0
            , &key_physical_attrs 100 100 100 100 0 0 0
            , &key_physical_attrs 100 100 200 100 0 0 0
            , &key_physical_attrs 100 100 300 100 0 0 0
            , &key_physical_attrs 100 100 400 100 0 0 0
            , &key_physical_attrs 100 100 500 100 0 0 0
            , &key_physical_attrs 100 100 0 200 0 0 0
            , &key_physical_attrs 100 100 100 200 0 0 0
            , &key_physical_attrs 100 100 200 200 0 0 0
            , &key_physical_attrs 100 100 300 200 0 0 0
            , &key_physical_attrs 100 100 400 200 0 0 0
            , &key_physical_attrs 100 100 500 200 0 0 0
            , &key_physical_attrs 100 100 0 300 0 0 0
            , &key_physical_attrs 100 100 100 300 0 0 0
            , &key_physical_attrs 100 100 200 300 0 0 0
            , &key_physical_attrs 100 100 300 300 0 0 0
            , &key_physical_attrs 100 100 400 300 0 0 0
            , &key_physical_attrs 100 100 500 300 0 0 0
            , &key_physical_attrs 100 100 0 400 0 0 0
            , &key_physical_attrs 100 100 100 400 0 0 0
            , &key_physical_attrs 100 100 200 400 0 0 0
            , &key_physical_attrs 100 100 300 400 0 0 0
            ;
    };
};

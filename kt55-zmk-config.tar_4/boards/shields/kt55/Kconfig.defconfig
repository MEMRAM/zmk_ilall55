## kt55-zmk-config.tar_4/boards/shields/kt55/Kconfig.defconfig
```kconfig
if SHIELD_KT55_LEFT

config ZMK_KEYBOARD_NAME
    default "KT55"

config ZMK_SPLIT_ROLE_CENTRAL
    default y

endif # SHIELD_KT55_LEFT

if SHIELD_KT55_RIGHT

config ZMK_KEYBOARD_NAME
    default "KT55"

endif # SHIELD_KT55_RIGHT

if SHIELD_KT55_LEFT || SHIELD_KT55_RIGHT

config ZMK_SPLIT
    default y

endif
```

## kt55-zmk-config.tar_4/boards/shields/kt55/Kconfig.shield
```kconfig
config SHIELD_KT55_LEFT
    def_bool $(shields_list_contains,kt55_left)

config SHIELD_KT55_RIGHT
    def_bool $(shields_list_contains,kt55_right)
```
